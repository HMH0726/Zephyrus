## projects/0709/build/Kconfig/arch/Kconfig
```kconfig
# Load Zephyr Arch Kconfig descriptions.
osource "D:/Users/ORESANJO/Downloads/Zephyrus/workspace/zephyrproject/zephyr/arch/rx/Kconfig"
osource "D:/Users/ORESANJO/Downloads/Zephyrus/workspace/zephyrproject/zephyr/arch/x86/Kconfig"
osource "D:/Users/ORESANJO/Downloads/Zephyrus/workspace/zephyrproject/zephyr/arch/xtensa/Kconfig"
osource "D:/Users/ORESANJO/Downloads/Zephyrus/workspace/zephyrproject/zephyr/arch/sparc/Kconfig"
osource "D:/Users/ORESANJO/Downloads/Zephyrus/workspace/zephyrproject/zephyr/arch/riscv/Kconfig"
osource "D:/Users/ORESANJO/Downloads/Zephyrus/workspace/zephyrproject/zephyr/arch/posix/Kconfig"
osource "D:/Users/ORESANJO/Downloads/Zephyrus/workspace/zephyrproject/zephyr/arch/openrisc/Kconfig"
osource "D:/Users/ORESANJO/Downloads/Zephyrus/workspace/zephyrproject/zephyr/arch/mips/Kconfig"
osource "D:/Users/ORESANJO/Downloads/Zephyrus/workspace/zephyrproject/zephyr/arch/arm64/Kconfig"
osource "D:/Users/ORESANJO/Downloads/Zephyrus/workspace/zephyrproject/zephyr/arch/arm/Kconfig"
osource "D:/Users/ORESANJO/Downloads/Zephyrus/workspace/zephyrproject/zephyr/arch/arc/Kconfig"
```

## projects/0709/build/Kconfig/soc/Kconfig
```kconfig
# Load Zephyr SoC Kconfig descriptions.
osource "D:/Users/ORESANJO/Downloads/Zephyrus/workspace/zephyrproject/zephyr/soc/xlnx/zynqmp/Kconfig"
osource "D:/Users/ORESANJO/Downloads/Zephyrus/workspace/zephyrproject/zephyr/soc/xlnx/zynq7000/Kconfig"
osource "D:/Users/ORESANJO/Downloads/Zephyrus/workspace/zephyrproject/zephyr/soc/xlnx/versalnet/Kconfig"
osource "D:/Users/ORESANJO/Downloads/Zephyrus/workspace/zephyrproject/zephyr/soc/xlnx/versal2/Kconfig"
osource "D:/Users/ORESANJO/Downloads/Zephyrus/workspace/zephyrproject/zephyr/soc/xlnx/versal/Kconfig"
osource "D:/Users/ORESANJO/Downloads/Zephyrus/workspace/zephyrproject/zephyr/soc/xen/Kconfig"
osource "D:/Users/ORESANJO/Downloads/Zephyrus/workspace/zephyrproject/zephyr/soc/wch/ch32v/Kconfig"
osource "D:/Users/ORESANJO/Downloads/Zephyrus/workspace/zephyrproject/zephyr/soc/ti/simplelink/Kconfig"
osource "D:/Users/ORESANJO/Downloads/Zephyrus/workspace/zephyrproject/zephyr/soc/ti/mspm0/Kconfig"
osource "D:/Users/ORESANJO/Downloads/Zephyrus/workspace/zephyrproject/zephyr/soc/ti/lm3s6965/Kconfig"
osource "D:/Users/ORESANJO/Downloads/Zephyrus/workspace/zephyrproject/zephyr/soc/ti/k3/Kconfig"
osource "D:/Users/ORESANJO/Downloads/Zephyrus/workspace/zephyrproject/zephyr/soc/telink/tlsr/Kconfig"
osource "D:/Users/ORESANJO/Downloads/Zephyrus/workspace/zephyrproject/zephyr/soc/syna/sr100/Kconfig"
osource "D:/Users/ORESANJO/Downloads/Zephyrus/workspace/zephyrproject/zephyr/soc/starfive/jh71xx/Kconfig"
osource "D:/Users/ORESANJO/Downloads/Zephyrus/workspace/zephyrproject/zephyr/soc/st/stm32/Kconfig"
osource "D:/Users/ORESANJO/Downloads/Zephyrus/workspace/zephyrproject/zephyr/soc/snps/qemu_arc/Kconfig"
osource "D:/Users/ORESANJO/Downloads/Zephyrus/workspace/zephyrproject/zephyr/soc/snps/nsim/arc_v/Kconfig"
osource "D:/Users/ORESANJO/Downloads/Zephyrus/workspace/zephyrproject/zephyr/soc/snps/nsim/arc_classic/Kconfig"
osource "D:/Users/ORESANJO/Downloads/Zephyrus/workspace/zephyrproject/zephyr/soc/snps/hsdk4xd/Kconfig"
osource "D:/Users/ORESANJO/Downloads/Zephyrus/workspace/zephyrproject/zephyr/soc/snps/hsdk/Kconfig"
osource "D:/Users/ORESANJO/Downloads/Zephyrus/workspace/zephyrproject/zephyr/soc/snps/emsk/Kconfig"
osource "D:/Users/ORESANJO/Downloads/Zephyrus/workspace/zephyrproject/zephyr/soc/snps/emsdp/Kconfig"
osource "D:/Users/ORESANJO/Downloads/Zephyrus/workspace/zephyrproject/zephyr/soc/snps/arc_iot/Kconfig"
osource "D:/Users/ORESANJO/Downloads/Zephyrus/workspace/zephyrproject/zephyr/soc/silabs/Kconfig"
osource "D:/Users/ORESANJO/Downloads/Zephyrus/workspace/zephyrproject/zephyr/soc/sifli/sf32/Kconfig"
osource "D:/Users/ORESANJO/Downloads/Zephyrus/workspace/zephyrproject/zephyr/soc/sifive/sifive_freedom/Kconfig"
osource "D:/Users/ORESANJO/Downloads/Zephyrus/workspace/zephyrproject/zephyr/soc/sensry/Kconfig"
osource "D:/Users/ORESANJO/Downloads/Zephyrus/workspace/zephyrproject/zephyr/soc/rockchip/Kconfig"
osource "D:/Users/ORESANJO/Downloads/Zephyrus/workspace/zephyrproject/zephyr/soc/renode/riscv_virtual/Kconfig"
osource "D:/Users/ORESANJO/Downloads/Zephyrus/workspace/zephyrproject/zephyr/soc/renode/cortex_r8_virtual/Kconfig"
osource "D:/Users/ORESANJO/Downloads/Zephyrus/workspace/zephyrproject/zephyr/soc/renesas/smartbond/Kconfig"
osource "D:/Users/ORESANJO/Downloads/Zephyrus/workspace/zephyrproject/zephyr/soc/renesas/rz/Kconfig"
osource "D:/Users/ORESANJO/Downloads/Zephyrus/workspace/zephyrproject/zephyr/soc/renesas/rx/Kconfig"
osource "D:/Users/ORESANJO/Downloads/Zephyrus/workspace/zephyrproject/zephyr/soc/renesas/rcar/Kconfig"
osource "D:/Users/ORESANJO/Downloads/Zephyrus/workspace/zephyrproject/zephyr/soc/renesas/ra/Kconfig"
osource "D:/Users/ORESANJO/Downloads/Zephyrus/workspace/zephyrproject/zephyr/soc/realtek/fingerprint/Kconfig"
osource "D:/Users/ORESANJO/Downloads/Zephyrus/workspace/zephyrproject/zephyr/soc/realtek/ec/Kconfig"
osource "D:/Users/ORESANJO/Downloads/Zephyrus/workspace/zephyrproject/zephyr/soc/realtek/bee/Kconfig"
osource "D:/Users/ORESANJO/Downloads/Zephyrus/workspace/zephyrproject/zephyr/soc/realtek/ameba/Kconfig"
osource "D:/Users/ORESANJO/Downloads/Zephyrus/workspace/zephyrproject/zephyr/soc/raspberrypi/rpi_pico/Kconfig"
osource "D:/Users/ORESANJO/Downloads/Zephyrus/workspace/zephyrproject/zephyr/soc/quicklogic/eos_s3/Kconfig"
osource "D:/Users/ORESANJO/Downloads/Zephyrus/workspace/zephyrproject/zephyr/soc/qemu/virt_riscv/Kconfig"
osource "D:/Users/ORESANJO/Downloads/Zephyrus/workspace/zephyrproject/zephyr/soc/qemu/or1k/Kconfig"
osource "D:/Users/ORESANJO/Downloads/Zephyrus/workspace/zephyrproject/zephyr/soc/qemu/malta/Kconfig"
osource "D:/Users/ORESANJO/Downloads/Zephyrus/workspace/zephyrproject/zephyr/soc/openisa/rv32m1/Kconfig"
osource "D:/Users/ORESANJO/Downloads/Zephyrus/workspace/zephyrproject/zephyr/soc/openhwgroup/cva6/Kconfig"
osource "D:/Users/ORESANJO/Downloads/Zephyrus/workspace/zephyrproject/zephyr/soc/oct/osd32mp15x/Kconfig"
osource "D:/Users/ORESANJO/Downloads/Zephyrus/workspace/zephyrproject/zephyr/soc/nxp/s32/Kconfig"
osource "D:/Users/ORESANJO/Downloads/Zephyrus/workspace/zephyrproject/zephyr/soc/nxp/rw/Kconfig"
osource "D:/Users/ORESANJO/Downloads/Zephyrus/workspace/zephyrproject/zephyr/soc/nxp/mcx/Kconfig"
osource "D:/Users/ORESANJO/Downloads/Zephyrus/workspace/zephyrproject/zephyr/soc/nxp/lpc/Kconfig"
osource "D:/Users/ORESANJO/Downloads/Zephyrus/workspace/zephyrproject/zephyr/soc/nxp/layerscape/Kconfig"
osource "D:/Users/ORESANJO/Downloads/Zephyrus/workspace/zephyrproject/zephyr/soc/nxp/kinetis/Kconfig"
osource "D:/Users/ORESANJO/Downloads/Zephyrus/workspace/zephyrproject/zephyr/soc/nxp/imxrt/Kconfig"
osource "D:/Users/ORESANJO/Downloads/Zephyrus/workspace/zephyrproject/zephyr/soc/nxp/imx/Kconfig"
osource "D:/Users/ORESANJO/Downloads/Zephyrus/workspace/zephyrproject/zephyr/soc/nuvoton/numicro/Kconfig"
osource "D:/Users/ORESANJO/Downloads/Zephyrus/workspace/zephyrproject/zephyr/soc/nuvoton/numaker/Kconfig"
osource "D:/Users/ORESANJO/Downloads/Zephyrus/workspace/zephyrproject/zephyr/soc/nuvoton/npcx/Kconfig"
osource "D:/Users/ORESANJO/Downloads/Zephyrus/workspace/zephyrproject/zephyr/soc/nuvoton/npcm/Kconfig"
osource "D:/Users/ORESANJO/Downloads/Zephyrus/workspace/zephyrproject/zephyr/soc/nordic/Kconfig"
osource "D:/Users/ORESANJO/Downloads/Zephyrus/workspace/zephyrproject/zephyr/soc/neorv32/Kconfig"
osource "D:/Users/ORESANJO/Downloads/Zephyrus/workspace/zephyrproject/zephyr/soc/native/inf_clock/Kconfig"
osource "D:/Users/ORESANJO/Downloads/Zephyrus/workspace/zephyrproject/zephyr/soc/microchip/sam/sama7/Kconfig"
osource "D:/Users/ORESANJO/Downloads/Zephyrus/workspace/zephyrproject/zephyr/soc/microchip/sam/sam_d5x_e5x/Kconfig"
osource "D:/Users/ORESANJO/Downloads/Zephyrus/workspace/zephyrproject/zephyr/soc/microchip/pic64/Kconfig"
osource "D:/Users/ORESANJO/Downloads/Zephyrus/workspace/zephyrproject/zephyr/soc/microchip/pic32c/pic32cz_ca/Kconfig"
osource "D:/Users/ORESANJO/Downloads/Zephyrus/workspace/zephyrproject/zephyr/soc/microchip/pic32c/pic32cx_sg/Kconfig"
osource "D:/Users/ORESANJO/Downloads/Zephyrus/workspace/zephyrproject/zephyr/soc/microchip/pic32c/pic32cm_pl/Kconfig"
osource "D:/Users/ORESANJO/Downloads/Zephyrus/workspace/zephyrproject/zephyr/soc/microchip/pic32c/pic32cm_jh/Kconfig"
osource "D:/Users/ORESANJO/Downloads/Zephyrus/workspace/zephyrproject/zephyr/soc/microchip/miv/Kconfig"
osource "D:/Users/ORESANJO/Downloads/Zephyrus/workspace/zephyrproject/zephyr/soc/microchip/mec/Kconfig"
osource "D:/Users/ORESANJO/Downloads/Zephyrus/workspace/zephyrproject/zephyr/soc/mediatek/mt8xxx/Kconfig"
osource "D:/Users/ORESANJO/Downloads/Zephyrus/workspace/zephyrproject/zephyr/soc/lowrisc/opentitan/Kconfig"
osource "D:/Users/ORESANJO/Downloads/Zephyrus/workspace/zephyrproject/zephyr/soc/litex/litex_vexriscv/Kconfig"
osource "D:/Users/ORESANJO/Downloads/Zephyrus/workspace/zephyrproject/zephyr/soc/ite/ec/Kconfig"
osource "D:/Users/ORESANJO/Downloads/Zephyrus/workspace/zephyrproject/zephyr/soc/intel/wildcat_lake/Kconfig"
osource "D:/Users/ORESANJO/Downloads/Zephyrus/workspace/zephyrproject/zephyr/soc/intel/raptor_lake/Kconfig"
osource "D:/Users/ORESANJO/Downloads/Zephyrus/workspace/zephyrproject/zephyr/soc/intel/panther_lake/Kconfig"
osource "D:/Users/ORESANJO/Downloads/Zephyrus/workspace/zephyrproject/zephyr/soc/intel/lakemont/Kconfig"
osource "D:/Users/ORESANJO/Downloads/Zephyrus/workspace/zephyrproject/zephyr/soc/intel/intel_socfpga_std/Kconfig"
osource "D:/Users/ORESANJO/Downloads/Zephyrus/workspace/zephyrproject/zephyr/soc/intel/intel_socfpga/Kconfig"
osource "D:/Users/ORESANJO/Downloads/Zephyrus/workspace/zephyrproject/zephyr/soc/intel/intel_niosv/Kconfig"
osource "D:/Users/ORESANJO/Downloads/Zephyrus/workspace/zephyrproject/zephyr/soc/intel/intel_ish/Kconfig"
osource "D:/Users/ORESANJO/Downloads/Zephyrus/workspace/zephyrproject/zephyr/soc/intel/intel_adsp/Kconfig"
osource "D:/Users/ORESANJO/Downloads/Zephyrus/workspace/zephyrproject/zephyr/soc/intel/elkhart_lake/Kconfig"
osource "D:/Users/ORESANJO/Downloads/Zephyrus/workspace/zephyrproject/zephyr/soc/intel/atom/Kconfig"
osource "D:/Users/ORESANJO/Downloads/Zephyrus/workspace/zephyrproject/zephyr/soc/intel/apollo_lake/Kconfig"
osource "D:/Users/ORESANJO/Downloads/Zephyrus/workspace/zephyrproject/zephyr/soc/intel/alder_lake/Kconfig"
osource "D:/Users/ORESANJO/Downloads/Zephyrus/workspace/zephyrproject/zephyr/soc/infineon/psoc4/Kconfig"
osource "D:/Users/ORESANJO/Downloads/Zephyrus/workspace/zephyrproject/zephyr/soc/infineon/edge/Kconfig"
osource "D:/Users/ORESANJO/Downloads/Zephyrus/workspace/zephyrproject/zephyr/soc/infineon/cat3/Kconfig"
osource "D:/Users/ORESANJO/Downloads/Zephyrus/workspace/zephyrproject/zephyr/soc/infineon/cat1c/Kconfig"
osource "D:/Users/ORESANJO/Downloads/Zephyrus/workspace/zephyrproject/zephyr/soc/infineon/cat1b/Kconfig"
osource "D:/Users/ORESANJO/Downloads/Zephyrus/workspace/zephyrproject/zephyr/soc/infineon/cat1a/Kconfig"
osource "D:/Users/ORESANJO/Downloads/Zephyrus/workspace/zephyrproject/zephyr/soc/gd/gd32/Kconfig"
osource "D:/Users/ORESANJO/Downloads/Zephyrus/workspace/zephyrproject/zephyr/soc/gaisler/leon3/Kconfig"
osource "D:/Users/ORESANJO/Downloads/Zephyrus/workspace/zephyrproject/zephyr/soc/gaisler/gr716a/Kconfig"
osource "D:/Users/ORESANJO/Downloads/Zephyrus/workspace/zephyrproject/zephyr/soc/focaltech/Kconfig"
osource "D:/Users/ORESANJO/Downloads/Zephyrus/workspace/zephyrproject/zephyr/soc/espressif/Kconfig"
osource "D:/Users/ORESANJO/Downloads/Zephyrus/workspace/zephyrproject/zephyr/soc/ene/kb1200/Kconfig"
osource "D:/Users/ORESANJO/Downloads/Zephyrus/workspace/zephyrproject/zephyr/soc/ene/kb106x/Kconfig"
osource "D:/Users/ORESANJO/Downloads/Zephyrus/workspace/zephyrproject/zephyr/soc/elan/em32f967/Kconfig"
osource "D:/Users/ORESANJO/Downloads/Zephyrus/workspace/zephyrproject/zephyr/soc/egis/Kconfig"
osource "D:/Users/ORESANJO/Downloads/Zephyrus/workspace/zephyrproject/zephyr/soc/efinix/sapphire/Kconfig"
osource "D:/Users/ORESANJO/Downloads/Zephyrus/workspace/zephyrproject/zephyr/soc/cdns/xtensa_sample_controller/Kconfig"
osource "D:/Users/ORESANJO/Downloads/Zephyrus/workspace/zephyrproject/zephyr/soc/cdns/swerv/Kconfig"
osource "D:/Users/ORESANJO/Downloads/Zephyrus/workspace/zephyrproject/zephyr/soc/cdns/sample_controller32/Kconfig"
osource "D:/Users/ORESANJO/Downloads/Zephyrus/workspace/zephyrproject/zephyr/soc/cdns/dc233c/Kconfig"
osource "D:/Users/ORESANJO/Downloads/Zephyrus/workspace/zephyrproject/zephyr/soc/brcm/bcmvk/Kconfig"
osource "D:/Users/ORESANJO/Downloads/Zephyrus/workspace/zephyrproject/zephyr/soc/brcm/bcm2712/Kconfig"
osource "D:/Users/ORESANJO/Downloads/Zephyrus/workspace/zephyrproject/zephyr/soc/brcm/bcm2711/Kconfig"
osource "D:/Users/ORESANJO/Downloads/Zephyrus/workspace/zephyrproject/zephyr/soc/blackberry/qnxhv_vm/Kconfig"
osource "D:/Users/ORESANJO/Downloads/Zephyrus/workspace/zephyrproject/zephyr/soc/bflb/Kconfig"
osource "D:/Users/ORESANJO/Downloads/Zephyrus/workspace/zephyrproject/zephyr/soc/atmel/sam0/Kconfig"
osource "D:/Users/ORESANJO/Downloads/Zephyrus/workspace/zephyrproject/zephyr/soc/atmel/sam/Kconfig"
osource "D:/Users/ORESANJO/Downloads/Zephyrus/workspace/zephyrproject/zephyr/soc/aspeed/Kconfig"
osource "D:/Users/ORESANJO/Downloads/Zephyrus/workspace/zephyrproject/zephyr/soc/arm/Kconfig"
osource "D:/Users/ORESANJO/Downloads/Zephyrus/workspace/zephyrproject/zephyr/soc/arm/beetle/Kconfig"
osource "D:/Users/ORESANJO/Downloads/Zephyrus/workspace/zephyrproject/zephyr/soc/antmicro/myra/Kconfig"
osource "D:/Users/ORESANJO/Downloads/Zephyrus/workspace/zephyrproject/zephyr/soc/andestech/Kconfig"
osource "D:/Users/ORESANJO/Downloads/Zephyrus/workspace/zephyrproject/zephyr/soc/amd/acp_6_0/Kconfig"
osource "D:/Users/ORESANJO/Downloads/Zephyrus/workspace/zephyrproject/zephyr/soc/ambiq/Kconfig"
osource "D:/Users/ORESANJO/Downloads/Zephyrus/workspace/zephyrproject/zephyr/soc/allwinner/sun8i_h3/Kconfig"
osource "D:/Users/ORESANJO/Downloads/Zephyrus/workspace/zephyrproject/zephyr/soc/alif/ensemble/Kconfig"
osource "D:/Users/ORESANJO/Downloads/Zephyrus/workspace/zephyrproject/zephyr/soc/aesc/Kconfig"
osource "D:/Users/ORESANJO/Downloads/Zephyrus/workspace/zephyrproject/zephyr/soc/adi/max32/Kconfig"
```

## projects/ETHWS/build/Kconfig/boards/Kconfig.defconfig.tmp
```kconfig
# Load Zephyr board defconfig descriptions.
osource "D:/Users/ORESANJO/Downloads/Zephyrus/workspace/zephyrproject/zephyr/boards/seeed/xiao_ble/Kconfig.defconfig"
```

## projects/ETHWS/build/Kconfig/boards/Kconfig.sysbuild.tmp
```kconfig
# Load Sysbuild board Kconfig descriptions.
osource "D:/Users/ORESANJO/Downloads/Zephyrus/workspace/zephyrproject/zephyr/boards/seeed/xiao_ble/Kconfig.sysbuild"
```

## projects/ETHWS/build/Kconfig/boards/Kconfig.xiao_ble.tmp
```kconfig
# Load board Kconfig descriptions.
osource "D:/Users/ORESANJO/Downloads/Zephyrus/workspace/zephyrproject/zephyr/boards/seeed/xiao_ble/Kconfig.xiao_ble"
```
