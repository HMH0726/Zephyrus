## projects/xiao_3ch_mouse/build/Kconfig/arch/Kconfig.tmp
```kconfig
# Load Zephyr Arch Kconfig descriptions.
osource "C:/Users/KKINGWORK/Music/Zephyrus/workspace/zephyrproject/zephyr/arch/rx/Kconfig"
osource "C:/Users/KKINGWORK/Music/Zephyrus/workspace/zephyrproject/zephyr/arch/x86/Kconfig"
osource "C:/Users/KKINGWORK/Music/Zephyrus/workspace/zephyrproject/zephyr/arch/xtensa/Kconfig"
osource "C:/Users/KKINGWORK/Music/Zephyrus/workspace/zephyrproject/zephyr/arch/sparc/Kconfig"
osource "C:/Users/KKINGWORK/Music/Zephyrus/workspace/zephyrproject/zephyr/arch/riscv/Kconfig"
osource "C:/Users/KKINGWORK/Music/Zephyrus/workspace/zephyrproject/zephyr/arch/posix/Kconfig"
osource "C:/Users/KKINGWORK/Music/Zephyrus/workspace/zephyrproject/zephyr/arch/openrisc/Kconfig"
osource "C:/Users/KKINGWORK/Music/Zephyrus/workspace/zephyrproject/zephyr/arch/mips/Kconfig"
osource "C:/Users/KKINGWORK/Music/Zephyrus/workspace/zephyrproject/zephyr/arch/arm64/Kconfig"
osource "C:/Users/KKINGWORK/Music/Zephyrus/workspace/zephyrproject/zephyr/arch/arm/Kconfig"
osource "C:/Users/KKINGWORK/Music/Zephyrus/workspace/zephyrproject/zephyr/arch/arc/Kconfig"
```

## projects/xiao_3ch_mouse/build/Kconfig/boards/Kconfig.defconfig
```kconfig
# Load Zephyr board defconfig descriptions.
osource "C:/Users/KKINGWORK/Music/Zephyrus/workspace/zephyrproject/zephyr/boards/seeed/xiao_ble/Kconfig.defconfig"
```

## projects/xiao_3ch_mouse/build/Kconfig/boards/Kconfig.xiao_ble.tmp
```kconfig
# Load board Kconfig descriptions.
osource "C:/Users/KKINGWORK/Music/Zephyrus/workspace/zephyrproject/zephyr/boards/seeed/xiao_ble/Kconfig.xiao_ble"
```
