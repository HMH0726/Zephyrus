## CMakeLists.txt
```
cmake_minimum_required(VERSION 3.20.0)

# 尋找 Zephyr 核心
find_package(Zephyr REQUIRED HINTS $ENV{ZEPHYR_BASE})

project(CLRFLASH)

# 指定主程式原始碼位置
target_sources(app PRIVATE src/main.c)
```

## prj.conf
```kconfig
# ==========================================
# CLRFLASH 基礎設定
# ==========================================
CONFIG_BT=y
CONFIG_BT_PERIPHERAL=y
CONFIG_BT_DEVICE_NAME="CLRFLASH"

# 開啟 GPIO 驅動
CONFIG_GPIO=y
```

## src/main.c
```c
#include <zephyr/kernel.h>
#include <zephyr/sys/printk.h>

int main(void) {
    printk("Hello World! 歡迎來到 CLRFLASH 的世界！\n");

    /* RTOS 主迴圈：每秒醒來一次，其他時間進入深度睡眠省電 */
    while (1) {
        k_sleep(K_MSEC(1000));
    }
    return 0;
}
```
