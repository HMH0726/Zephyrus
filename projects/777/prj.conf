## CMakeLists.txt
```
cmake_minimum_required(VERSION 3.20.0)

# 尋找 Zephyr 核心
find_package(Zephyr REQUIRED HINTS $ENV{ZEPHYR_BASE})

project(777)

# 指定主程式原始碼位置
target_sources(app PRIVATE src/main.c)
```

## prj.conf
```kconfig
# ==========================================
# 777 基礎設定
# ==========================================
CONFIG_BT=y
CONFIG_BT_PERIPHERAL=y
CONFIG_BT_DEVICE_NAME="777"

# 開啟 GPIO 驅動
CONFIG_GPIO=y
```

## app.overlay
```dts
/ {
    aliases {
        sw0 = &button0;
    };

    buttons {
        compatible = "gpio-keys";
        button0: button_0 {
            /* 預設綁定到 XIAO 的 D1 腳位 (P0.03) */
            gpios = <&gpio0 3 (GPIO_PULL_UP | GPIO_ACTIVE_LOW)>;
            label = "User Button";
        };
    };
};
```

## src/main.c
```c
#include <zephyr/kernel.h>
#include <zephyr/sys/printk.h>

int main(void) {
    printk("Hello World! 歡迎來到 777 的世界！\n");

    /* RTOS 主迴圈：每秒醒來一次，其他時間進入深度睡眠省電 */
    while (1) {
        k_sleep(K_MSEC(1000));
    }
    return 0;
}
```
